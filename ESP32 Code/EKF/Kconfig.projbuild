## ESP32 Code/EKF/Kconfig.projbuild
```kconfig
menu "EKF Parameters Definition"

    orsource "$IDF_PATH/examples/common_components/env_caps/$IDF_TARGET/Kconfig.env_caps"
    config EKF_SAMPLING_TIME_MS
        int "Sampling time"
        range 1 100
        default 20
        help
            The sampling time for the EKF in ms. This is used for updating the states but
            it is not enforced by the library, that is the responsibility of the application
            to call the EKF periodically.
    
    config EKF_NUM_OF_STATES
        int "Number of states"
        range 1 3
        default 1
        help
            This is the number of states that are estimated using the EKF and is also used in
            setting the dimensions of the state vector and matrices depenedent on it.
    
    config EKF_NUM_OF_OBSERVATIONS
        int "Number of observations"
        range 1 3
        default 1
        help
            This is the number of available observations that are available to the EKF for
            correcting its state estimate predictions
    
    config EKF_RETURN_STF_RESULTS
        bool "Return results of the STF calculation"
        help
            When activated the EKF "returns" the result of the calculation of the state transition
            function along with the state vector if that result is important to the application.
            
endmenu
```

## ESP32 Code/MPU6050/Kconfig.projbuild
```kconfig
menu "I2C Config for MPU6050"

    orsource "$IDF_PATH/examples/common_components/env_caps/$IDF_TARGET/Kconfig.env_caps"

    config I2C_MASTER_SCL
        int "GPIO number for SCL"
        range ENV_GPIO_RANGE_MIN ENV_GPIO_OUT_RANGE_MAX
        default 22 if IDF_TARGET_ESP32 || IDF_TARGET_ESP32S2 || IDF_TARGET_ESP32S3
        default 6
        help
            The GPIO pin that SCL will be connected to on the ESP32.
        
    config I2C_MASTER_SDA
        int "GPIO number for SDA"
        range ENV_GPIO_RANGE_MIN ENV_GPIO_OUT_RANGE_MAX
        default 21 if IDF_TARGET_ESP32 || IDF_TARGET_ESP32S2 || IDF_TARGET_ESP32S3
        default 6
        help
            The GPIO pin that SCL will be connected to on the ESP32.
    
    config I2C_MASTER_FREQ_HZ
        int "SCL Frequency (Hz)"
        range 100000 400000
        default 100000
        help
            The frequency, in Hz, of the SCL line supplied by the ESP32.

    config I2C_MASTER_PULLUP_EN
        bool "SCL and SDA Pullup Enable"
            help  
                Enable the internal pull-up resistor for SCL

endmenu
```
